## alternative/tailnet/components/microlink/components/wireguard_lwip/Kconfig.projbuild
```kconfig
menu "WireGuard crypto (wireguard_lwip)"

    config WG_CRYPTO_IRAM
        bool "Run ChaCha20-Poly1305 from IRAM"
        default n
        help
            Place the per-packet ChaCha20/Poly1305 code (about 5 KB) in IRAM instead of
            flash. Flash code runs through the instruction cache, which Wi-Fi and the
            TCP/IP stack share; if they evict the cipher's loops between packets every
            packet pays cache refills. Costs IRAM, which is scarce on this firmware:
            enable only if `crypto bench` shows "avg" well above "min".

    config WG_CRYPTO_BENCH_BASELINE
        bool "Include the original ChaCha20-Poly1305 in `crypto bench` for A/B comparison"
        default n
        help
            Links the pre-optimisation implementation (crypto/legacy) and prints its
            timings next to the optimised code. Diagnostics only; adds about 4 KB of flash.

endmenu
```

## components/tdongle_runtime/Kconfig
```kconfig
menu "T-Dongle memory diagnostics"
    config TDONGLE_MEMORY_DIAGNOSTICS
        bool "Memory diagnostics build (owner-tagged heap, per-phase capture, serial memory/members commands)"
        default n
        help
            Evidence build for the multi-tailnet memory work. Adds an owner-tagged
            allocation ledger (microlink sites plus mbedTLS), a per-membership heap
            capture at each join phase, an admission record and the serial
            "memory" / "members" commands. Costs about 2 KB of static RAM and a
            few instructions per tagged allocation. Leave off for release images:
            every hook compiles to the plain allocator call when this is off.

    config TDONGLE_MEMORY_GUARD_FLOOR_BYTES
        int "Free-heap floor enforced on tagged allocations and task creation (bytes)"
        depends on TDONGLE_MEMORY_DIAGNOSTICS
        range 0 65536
        default 12288
        help
            A tagged allocation that would leave less internal heap than this is
            refused (counted as denied) and a membership task whose stack would
            do the same is not created. This turns an out-of-memory crash during
            an over-budget membership into an ordinary start failure. Adjustable
            at run time with "memory guard <bytes>".

    config TDONGLE_MEMORY_ADMISSION_OVERRIDE
        bool "Start memberships past member_start_budget() (diagnostics only)"
        depends on TDONGLE_MEMORY_DIAGNOSTICS
        default y
        help
            Replaces the 107 KB budget and 24,000 B largest-block gate with the
            guard floor above, so a second membership can be attempted and its
            cost measured. Failed attempts are retried at most once a minute and
            every attempt is recorded by the "members" command.

    config TDONGLE_QUEUE_DEPTH_SWEEP
        int "Relay queue depth override for the throughput sweep (0 keeps 8/8/8/4)"
        depends on TDONGLE_MEMORY_DIAGNOSTICS
        range 0 8
        default 0
        help
            Sets the per-membership DERP TX, DISCO RX and WG RX queue depths to this
            value and the STUN RX depth to the smaller of this value and 4. Build
            one image per depth (1, 2, 4, 8) for the queue-depth sweep (issue #10).
endmenu
```

## main/Kconfig.projbuild
```kconfig
menu "T-Dongle-S3 device"
 config TDONGLE_SETUP_AP_OPEN
  bool "Open (passwordless) setup Wi-Fi access point"
  default y
  help
   The setup access point (TDongle-XXXXXX, shown on the screen) has no password, so anyone in range can open the setup page
   while setup is running (at most 10 minutes) and can add or delete saved Wi-Fi networks. This is the v0.1.x behaviour and an
   explicit owner decision: a phone joins it with one tap. The page can only change Wi-Fi networks; tailnets, the routing mode and
   diagnostics are never served on it. Turn it off to protect the access point with a random WPA2 password that the screen shows.
 config TDONGLE_WIFI_ROAMING_TAILNET
  bool "802.11k/v roaming assist in tailnet gateway mode"
  default n
  help
   The Wi-Fi bridge asks the access point to steer it to a better one (802.11k neighbour reports, 802.11v BSS transition requests), as
   v0.1.x did. The tailnet gateway does not by default: a roam briefly drops the Wi-Fi link and the tunnels with it, and its heap margin
   has not been measured with the feature on the board. Turn it on to measure.
endmenu
```
