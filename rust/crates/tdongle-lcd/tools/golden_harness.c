/* Golden harness for tdongle-lcd: compiles the REAL lcd_view.c (included, so its static glyph table and renderer are reachable), the real
 * traffic.c formatters and the real ui_settings.c duty function. Reads scenarios.txt (written by gen_golden.py), writes expected.txt and
 * frames.bin. Nothing here re-implements firmware behaviour. */
#include "lcd_view.c"
#include "ui_settings.h"
#include <assert.h>
#include <stdlib.h>

void traffic_format_mbps(char *out, unsigned size, uint32_t kbps_value);
void traffic_format_megabytes(char *out, unsigned size, uint64_t bytes);

static FILE *expected, *frames;
static long frames_pos;

static int unhex1(int c) { return c <= '9' ? c - '0' : (c | 32) - 'a' + 10; }
static size_t unhex(const char *s, uint8_t *out, size_t cap) {
    size_t n = 0;
    while (s[0] && s[1] && n < cap) { out[n++] = (uint8_t)(unhex1(s[0]) * 16 + unhex1(s[1])); s += 2; }
    return n;
}
static void puthex(FILE *f, const uint8_t *p, size_t n) { for (size_t i = 0; i < n; i++) fprintf(f, "%02x", p[i]); }
static uint32_t crc_update(uint32_t crc, const uint8_t *p, size_t n) {
    for (size_t i = 0; i < n; i++) { crc ^= p[i]; for (int k = 0; k < 8; k++) crc = (crc >> 1) ^ (0xEDB88320u & -(crc & 1)); }
    return crc;
}
/* CRC-32 over the little endian bytes of rows 0..=81 and 255 (rows >= 80 are background-only lines). */
static uint32_t pixel_crc(const lcd_view *v) {
    uint32_t crc = 0xFFFFFFFFu;
    for (unsigned k = 0; k < 83; k++) {
        unsigned y = k < 82 ? k : 255;
        uint16_t px[160];
        lcd_render_row(v, y, px);
        for (unsigned x = 0; x < 160; x++) { uint8_t b[2] = {(uint8_t)(px[x] & 255), (uint8_t)(px[x] >> 8)}; crc = crc_update(crc, b, 2); }
    }
    return ~crc;
}
/* Run-length coding of the 80 visible rows: per row a u8 run count, then (u16 LE value, u8 length) runs. */
static void frame_rle(const lcd_view *v) {
    for (unsigned y = 0; y < 80; y++) {
        uint16_t px[160];
        lcd_render_row(v, y, px);
        uint8_t runs[160 * 3];
        unsigned n = 0, x = 0;
        while (x < 160) {
            unsigned len = 1;
            while (x + len < 160 && px[x + len] == px[x] && len < 255) len++;
            runs[n * 3] = (uint8_t)(px[x] & 255); runs[n * 3 + 1] = (uint8_t)(px[x] >> 8); runs[n * 3 + 2] = (uint8_t)len;
            n++; x += len;
        }
        fputc((int)n, frames);
        fwrite(runs, 3, n, frames);
    }
}
static void emit_view(const char *name, const lcd_view *v, int with_frame) {
    fprintf(expected, "%s view=", name);
    puthex(expected, (const uint8_t *)v, sizeof(*v));
    fprintf(expected, " crc=%08x", pixel_crc(v));
    if (with_frame) { long start = ftell(frames); frame_rle(v); fprintf(expected, " frame=%ld:%ld", start, ftell(frames) - start); }
    fputc('\n', expected);
}

/* ---- state fields from key=value ---- */
#define U32(f) if (!strcmp(key, #f)) { s.f = (unsigned)strtoull(val, NULL, 10); continue; }
#define U64(f) if (!strcmp(key, #f)) { s.f = strtoull(val, NULL, 10); continue; }
#define B(f) if (!strcmp(key, #f)) { s.f = atoi(val) != 0; continue; }
#define HEX(f) if (!strcmp(key, #f)) { unhex(val, (uint8_t *)s.f, sizeof(s.f)); continue; }

int main(int argc, char **argv) {
    assert(argc == 4);
    FILE *in = fopen(argv[1], "r");
    expected = fopen(argv[2], "w");
    frames = fopen(argv[3], "wb+");
    assert(in && expected && frames);
    assert(sizeof(lcd_view) == 170 && sizeof(lcd_state) > 0);
    fprintf(expected, "# generated by gen_golden.py from the real C; sizeof(lcd_view)=%zu\n", sizeof(lcd_view));
    char *line = NULL; size_t cap = 0;
    while (getline(&line, &cap, in) > 0) {
        size_t L = strlen(line); while (L && (line[L - 1] == '\n' || line[L - 1] == '\r')) line[--L] = 0;
        if (!L || line[0] == '#') continue;
        char *save, *kind = strtok_r(line, " ", &save), *name = strtok_r(NULL, " ", &save);
        if (kind[0] == 'S') {
            lcd_state s; memset(&s, 0, sizeof s);
            char version[64] = "0.3.0"; int full = 0;
            for (char *tok; (tok = strtok_r(NULL, " ", &save));) {
                char *val = strchr(tok, '='); *val++ = 0; const char *key = tok;
                if (!strcmp(key, "ver")) { size_t n = unhex(val, (uint8_t *)version, 63); version[n] = 0; continue; }
                if (!strcmp(key, "full")) { full = atoi(val); continue; }
                B(bridge) B(wifi) B(saved_wifi) B(recovery) B(starting) B(installing) B(usb) B(usb_configured) B(usb_suspended)
                U32(saved) U32(enabled) U32(ready) U32(login) U32(failed) U32(page) B(rssi_valid)
                if (!strcmp(key, "rssi")) { s.rssi = atoi(val); continue; }
                HEX(ssid) B(setup) HEX(ap_ssid) U32(setup_seconds_left) U32(down_kbps) U32(up_kbps) U64(down_bytes) U64(up_bytes) U64(down_frames) U64(up_frames)
                HEX(bars) U32(uptime_s) U32(wifi_up_s) U32(connects) U32(last_reason) U32(usb_resets) U32(heap_free) U32(heap_min) U32(heap_largest)
                U32(reset_reason) U32(boots) U32(watchdogs) U32(panics) U32(health_view) U32(active_slot) HEX(active_name)
                fprintf(stderr, "unknown key %s\n", key); return 1;
            }
            lcd_view v; memset(&v, 0x5a, sizeof v);   /* lcd_compose must memset it: poison first */
            lcd_compose(&s, version, &v);
            emit_view(name, &v, full);
        } else if (kind[0] == 'V') {
            lcd_view v; memset(&v, 0, sizeof v);
            for (char *tok; (tok = strtok_r(NULL, " ", &save));) {
                char *val = strchr(tok, '='); *val++ = 0;
                if (!strcmp(tok, "text")) unhex(val, (uint8_t *)&v, 135);
                else if (!strcmp(tok, "bars")) unhex(val, v.bars, 32);
                else if (!strcmp(tok, "attention")) v.attention = atoi(val) != 0;
                else if (!strcmp(tok, "layout")) v.layout = (uint8_t)atoi(val);
                else if (!strcmp(tok, "bar_count")) v.bar_count = (uint8_t)atoi(val);
            }
            emit_view(name, &v, 0);
        } else if (kind[0] == 'R') {
            char rows[LCD_ROWS][27]; bool attention = false; memset(rows, 0, sizeof rows);
            for (char *tok; (tok = strtok_r(NULL, " ", &save));) {
                char *val = strchr(tok, '='); *val++ = 0;
                if (!strcmp(tok, "rows")) unhex(val, (uint8_t *)rows, sizeof rows);
                else if (!strcmp(tok, "attention")) attention = atoi(val) != 0;
            }
            lcd_view v; memset(&v, 0x5a, sizeof v);
            lcd_compose_rows(&v, (const char (*)[27])rows, attention);
            emit_view(name, &v, 1);
        } else if (kind[0] == 'F') {   /* F name kind size value */
            char *k = strtok_r(NULL, " ", &save); unsigned size = (unsigned)atoi(strtok_r(NULL, " ", &save));
            uint64_t val = strtoull(strtok_r(NULL, " ", &save), NULL, 10);
            char out[64]; memset(out, 0, sizeof out);
            if (!strcmp(k, "dur")) lcd_format_duration(out, size, (uint32_t)val);
            else if (!strcmp(k, "cnt")) lcd_format_count(out, size, val);
            else if (!strcmp(k, "mbps")) traffic_format_mbps(out, size, (uint32_t)val);
            else traffic_format_megabytes(out, size, val);
            fprintf(expected, "%s out=", name); puthex(expected, (uint8_t *)out, strlen(out)); fputc('\n', expected);
        } else if (kind[0] == 'D') {
            unsigned p = (unsigned)atoi(strtok_r(NULL, " ", &save));
            fprintf(expected, "%s duty=%u\n", name, ui_settings_backlight_duty(p));
        } else if (kind[0] == 'G') {   /* every byte value: toupper + table, 7 rows each */
            fprintf(expected, "%s glyphs=", name);
            for (unsigned c = 0; c < 256; c++) for (unsigned r = 0; r < 7; r++) fprintf(expected, "%02x", glyph((char)c, r));
            fputc('\n', expected);
        }
    }
    fclose(expected); fclose(frames);
    return 0;
}
